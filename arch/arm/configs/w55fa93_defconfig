## arch/arm/mach-w55fa93/Kconfig
```kconfig
if ARCH_W55FA93

config CPU_W55FA93
	bool
	default y

menu "W55FA93 Machines"

config ARCH_W55FA93DEV
	bool "W55FA93 DEV-Nuvoton Evaluation Kit"
	select CPU_W55FA93
	help
	   Say Y here if you are using the Nuvoton Evaluation Kit W55FA93 Demo Board
           <http://www.nuvoton.com>       

choice
	prompt "External Crystal"
	default EXTCLK_12M

config EXTCLK_12M
	bool "12MHz"

config EXTCLK_27M
	bool "27MHz"

endchoice


config SET_CPU_CLOCK_BY_BOOT_CODE
       bool "CPU clock set by boot code"
       default n
       help
       Say Y here only if target system clock is configured by boot code

choice
	prompt "System Clock"
	default SYSCLK_240_120_60
	depends on !SET_CPU_CLOCK_BY_BOOT_CODE

config SYSCLK_240_120_60
	bool "CPU 240MHz, AHB 120MHz, APB 60MHz"
	
config SYSCLK_192_96_48
	bool "CPU 192MHz, AHB 96MHz, APB 48MHz"

config SYSCLK_96_96_48
	bool "CPU 96MHz, AHB 48MHz, APB 48MHz"		

endchoice

choice
        prompt "Kernel Load Address"
        default LD_ADDR_0
	help
           Default kernel load address for SD boot and NAND boot is 0x00000000. 
           Set to 0x00008000 only if you know what you are doing

config LD_ADDR_0
        bool "0x00000000"

config LD_ADDR_8000
        bool "0x00008000"
endchoice

endmenu
endif
```

## drivers/input/misc/Kconfig
```kconfig
#
# Input misc drivers configuration
#
menuconfig INPUT_MISC
	bool "Miscellaneous devices"
	help
	  Say Y here, and a list of miscellaneous input drivers will be displayed.
	  Everything that didn't fit into the other categories is here. This option
	  doesn't affect the kernel.

	  If unsure, say Y.

if INPUT_MISC

config INPUT_PCSPKR
	tristate "PC Speaker support"
	depends on ALPHA || X86 || MIPS || PPC_PREP || PPC_CHRP || PPC_PSERIES
	help
	  Say Y here if you want the standard PC Speaker to be used for
	  bells and whistles.

	  If unsure, say Y.

	  To compile this driver as a module, choose M here: the
	  module will be called pcspkr.

config INPUT_SPARCSPKR
	tristate "SPARC Speaker support"
	depends on PCI && SPARC
	help
	  Say Y here if you want the standard Speaker on Sparc PCI systems
	  to be used for bells and whistles.

	  If unsure, say Y.

	  To compile this driver as a module, choose M here: the
	  module will be called sparcspkr.

config INPUT_M68K_BEEP
	tristate "M68k Beeper support"
	depends on M68K

config INPUT_WISTRON_BTNS
	tristate "x86 Wistron laptop button interface"
	depends on X86 && !X86_64
	help
	  Say Y here for support of Winstron laptop button interface, used on
	  laptops of various brands, including Acer and Fujitsu-Siemens.

	  To compile this driver as a module, choose M here: the module will
	  be called wistron_btns.

config INPUT_IXP4XX_BEEPER
	tristate "IXP4XX Beeper support"
	depends on ARCH_IXP4XX
	help
	  If you say yes here, you can connect a beeper to the
	  ixp4xx gpio pins. This is used by the LinkSys NSLU2.

	  If unsure, say Y.

	  To compile this driver as a module, choose M here: the
	  module will be called ixp4xx-beeper.

config INPUT_UINPUT
	tristate "User level driver support"
	help
	  Say Y here if you want to support user level drivers for input
	  subsystem accessible under char device 10:223 - /dev/input/uinput.

	  To compile this driver as a module, choose M here: the
	  module will be called uinput.

config HP_SDC_RTC
	tristate "HP SDC Real Time Clock"       
	depends on GSC
	select HP_SDC
	help
	  Say Y here if you want to support the built-in real time clock
	  of the HP SDC controller.

config W55FA93_KEYPAD
        bool "Nuvoton W55FA93 Keypad Support"
        depends on INPUT&&ARCH_W55FA93

choice
        prompt "Keypad type"
        default W55FA93_KEYPAD_3X3_I
	depends on  W55FA93_KEYPAD
	
config W55FA93_KEYPAD_1X4_I
        bool "1 x 4 event interface"

config W55FA93_KEYPAD_3X3_I
        bool "3 x 3 event interface"

config W55FA93_KEYPAD_8_BUTTONS
        bool "8 buttons"

config W55FA93_KEYPAD_MxN
        bool "M(ROW) x N(COL)"

config INPUT_KEYPAD_ROW
	int "Keypad row number"
	depends on W55FA93_KEYPAD_MxN
	default "8"

config INPUT_KEYPAD_COLUMN
	int "Keypad column number"
	depends on W55FA93_KEYPAD_MxN
	default "8"

endchoice

endif
```

## drivers/media/video/w55fa93_goodone/Kconfig
```kconfig
config W55FA93_VIDEOIN
	bool "W55FA93 video in support"
	depends on ARCH_W55FA93 && VIDEO_DEV
	---help---
	  Say Y here if you have W55FA93 chip(nuvoTon).

	  To compile this driver as a module, choose M here: the
	  module will be called w55fa93_videoin.

config SENSOR_OV9660
	bool "W55FA93 OV9660 sensor support"
	depends on ARCH_W55FA93 && VIDEO_DEV && W55FA93_VIDEOIN
	---help---
	  Say Y here if you have W55FA93 chip(nuvoTon).

config SENSOR_OV7670
	bool "W55FA93 OV7670 sensor support"
	depends on ARCH_W55FA93 && VIDEO_DEV && W55FA93_VIDEOIN
	---help---
	  Say Y here if you have W55FA93 chip(nuvoTon).
```
